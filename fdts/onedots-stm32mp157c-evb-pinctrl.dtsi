// SPDX-License-Identifier: (GPL-2.0+ OR BSD-3-Clause)
/*
 * Copyright (c) 2017-2023, STMicroelectronics - All Rights Reserved
 * Author: Ludovic Barre <ludovic.barre@st.com> for STMicroelectronics.
 */
#include <dt-bindings/pinctrl/stm32-pinfunc.h>

&pinctrl {
	uart4_pins_a: uart4-0 {
		pins1 {
			pinmux = <STM32_PINMUX('A',11,AF6)>;
			bias-disable;
		};
		pins2 {
			pinmux = <STM32_PINMUX('A',12,AF6)>;
			bias-disable;
			drive-push-pull;
			slew-rate = <0>;
		};
	};
};